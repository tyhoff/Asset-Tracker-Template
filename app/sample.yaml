## app/sample.yaml
```yaml
sample:
  name: Asset Tracker Template
  description: Modular, event-driven application framework for nRF91-based asset tracking devices.
tests:
  asset_tracker_template.app:
    sysbuild: true
    build_only: true
    integration_platforms:
      - thingy91x/nrf9151/ns
      - nrf9151dk/nrf9151/ns
    platform_allow:
      - thingy91x/nrf9151/ns
      - nrf9151dk/nrf9151/ns
    tags:
      - ci_build
      - sysbuild
  asset_tracker_template.app.survey:
    sysbuild: true
    build_only: true
    extra_args: EXTRA_CONF_FILE="overlay-survey.conf"
    integration_platforms:
      - thingy91x/nrf9151/ns
    platform_allow:
      - thingy91x/nrf9151/ns
    tags:
      - ci_build
      - sysbuild
```

## app/src/modules/survey/Kconfig.survey
```kconfig
# Copyright (c) 2026 Nordic Semiconductor
#
# SPDX-License-Identifier: LicenseRef-Nordic-5-Clause
#

menuconfig APP_SURVEY
	bool "Radio survey"
	depends on APP_LOCATION
	depends on LOCATION_METHOD_GNSS
	depends on LOCATION_METHOD_WIFI && LOCATION_METHOD_CELLULAR
	select APP_LOCATION_SCAN_TRIGGER
	select CBPRINTF_FP_SUPPORT
	help
	  Radio-survey data exporter. Captures GNSS fixes alongside the cell and
	  Wi-Fi observations visible at the same moment, for off-device analysis of
	  nRF Cloud Location Services accuracy.

	  Default n: the survey feature is additive and must never change the
	  behaviour of the asset-tracker application when disabled.

if APP_SURVEY

config APP_SURVEY_SHELL
	bool "Survey shell commands"
	depends on SHELL
	default y
	help
	  Register the "survey" shell command group, used to inspect captured
	  observations and to trigger captures manually from a console.

config APP_SURVEY_DROP_LOCAL_MAC
	bool "Drop access points with a locally-administered BSSID"
	default y
	help
	  Discard Wi-Fi access points whose BSSID has the IEEE 802 U/L bit set
	  (bit 1 of the first octet) as the scan is cached.

	  These are randomised BSSIDs: phone and laptop hotspots, Wi-Fi Direct
	  and CarPlay links. They re-randomise per session, so no positioning
	  service can resolve them to a location, and the whole point of the
	  survey is to be checked against one.

	  In a train carriage or a car park most of what is in the air is
	  randomised, so this is the difference between a record that resolves
	  and one that does not.

	  It does not recover access points that were crowded out. The Location
	  library caps its result set at
	  LOCATION_METHOD_WIFI_SCANNING_RESULTS_MAX_CNT (10 on this board) before
	  it publishes, and rejects a longer set outright rather than truncating,
	  so by the time a scan reaches the cache the real access points that the
	  randomised ones displaced are already gone. Recovering those means
	  raising that limit and APP_LOCATION_WIFI_APS_MAX with it, which is a
	  separate change with its own heap and record-size cost.

	  Applied where the scan is cached, so "survey show", "survey hex" and
	  the stored record all agree about what was seen. The count that was
	  dropped is reported by "survey show", so a genuinely quiet area can be
	  told apart from a filter discarding too much.

	  That count is also written into the stored record, at CDDL key 18, so
	  this option changes what goes on flash and not only what the console
	  prints. Records captured with it disabled carry no count, which on the
	  wire is indistinguishable from a scan in which nothing was randomised.

	  Disable to see the unfiltered scan on the bench, which is how to check
	  that claim rather than trust it.

config APP_SURVEY_STORAGE
	bool "Store survey records on flash"
	depends on APP_STORAGE_BACKEND_LITTLEFS
	depends on !APP_CLOUD_LOCATION
	help
	  Register encoded survey records as a storage data type, so a capture
	  survives power loss and can be read back after a drive.

	  Default n, and set explicitly in overlay-survey.conf rather than
	  defaulted on by the backend. Turning this on is not a small change: it
	  removes the LOCATION storage type (below), pushes STORAGE_MAX_DATA_SIZE
	  to 816 bytes, and so requires the matching APP_STORAGE_BATCH_BUFFER_SIZE
	  and APP_STORAGE_THREAD_STACK_SIZE that the overlay also sets. A build
	  that enabled APP_SURVEY just for the shell commands would otherwise
	  inherit all of that silently.

	  Enabling this also removes the LOCATION storage type from the build: the
	  survey record already carries the GNSS fix paired with the radio
	  observations taken at the same moment, whereas LOCATION stores the fix
	  and the scan as two unrelated records. Both types cannot be registered
	  at once in any case -- the LittleFS backend reserves
	  APP_STORAGE_MAX_RECORDS_PER_TYPE records for every registered type, and
	  the survey sets that high enough to fill the partition on its own.

	  That is why this depends on !APP_CLOUD_LOCATION: cloud.c references
	  STORAGE_TYPE_LOCATION under that symbol, so enabling both would fail to
	  compile with an undeclared identifier rather than anything readable.

	  Sizing: each record occupies SURVEY_STORE_SLOT_SIZE bytes on flash
	  regardless of how much it encodes to. See docs/modules/storage.md and
	  the note in survey_store.h.

config APP_SURVEY_SHELL_FILL
	bool "Bench command: survey fill <n>"
	depends on APP_SURVEY_SHELL && APP_SURVEY_STORAGE
	help
	  Adds "survey fill <n>", which stores n synthetic records back to back
	  and reports the elapsed time. It exists to measure what FW-6 could only
	  estimate: the real block cost of a full partition, and how store
	  latency behaves once the record directory holds thousands of files.

	  Drive it from the host in bounded bursts, not in one long run. This
	  loop is the only thing in the build that can outrun the storage
	  thread, and doing so exhausts the shared zbus net_buf pool, which
	  panics rather than fails -- see the hazard note in
	  overlay-survey.conf. No fixed interval avoids that, because the
	  per-record cost grows with the directory size. Records the command
	  acknowledged are on flash either way, so a long fill survives a
	  reboot; it just has to be re-driven.

	  Default n on purpose. The records it writes are synthetic, and although
	  they are marked as such in the observation cache, on flash they are
	  indistinguishable from captures -- a collection build with this enabled
	  is one mistyped command away from a corrupted data set. Enable it for a
	  measurement build only:

	    west build ... -- -DCONFIG_APP_SURVEY_SHELL_FILL=y

config APP_SURVEY_CAPTURE
	bool "Capture orchestrator (GNSS, scan, GNSS)"
	depends on APP_SURVEY_STORAGE && APP_LOCATION_SCAN_TRIGGER
	depends on APP_SURVEY_SHELL
	select LOCATION_DATA_DETAILS
	default y
	help
	  Runs the three location requests of one capture as a sequence on a
	  dedicated thread, and stores the result as a single record carrying both
	  GNSS fixes, the scan between them, and the offsets that relate them.

	  The sequencing is a hardware constraint, not a preference: the nRF9151
	  has one RF front end and cannot run GNSS and LTE at once, and the
	  Location library stops at the first method that succeeds, so a single
	  request listing GNSS and the radios returns a fix and never scans.

	  Enabling this makes the orchestrator the only thing that starts a
	  search. See APP_SURVEY_CAPTURE_OWNS_SEARCH.

	  Depends on APP_SURVEY_SHELL for historical reasons: "survey capture" was
	  the sole caller until APP_SURVEY_CAPTURE_INTERVAL_SECONDS (CP10) added
	  the cadence timer as a second, shell-independent one. Left in place
	  rather than dropped, since APP_SURVEY_SHELL defaults to y and a build
	  that disables it is already off the beaten path -- but the timer alone
	  is now enough to keep a device recording without a console attached.

	  Selects LOCATION_DATA_DETAILS because the orchestrator sequences on the
	  Location library's started event: it is what tells a step that the search
	  it just asked for is the one now running, so a search that finishes
	  belongs to it and not to something else. Without it the library never
	  reports started, and every step would wait its full timeout and then its
	  wind-down instead -- correct, but many minutes per cycle, and silent.

config APP_SURVEY_CAPTURE_OWNS_SEARCH
	bool "Suppress the application's own periodic location sampling"
	depends on APP_SURVEY_CAPTURE
	default y
	help
	  Makes the location module ignore LOCATION_SEARCH_TRIGGER, which is what
	  main.c publishes on its sampling timer and once at startup.

	  Two drivers cannot share the Location library. A trigger that arrives
	  while a search is running is discarded, so whichever one loses the race
	  simply does not happen -- and the capture cycle that loses a step
	  attributes the other driver's radio work to its own timestamps. The
	  startup sample is the worst case: it is GNSS-first and can hold the
	  library for the whole CONFIG_LOCATION_REQUEST_DEFAULT_GNSS_TIMEOUT,
	  which is 600 s by default.

	  Disable to get the upstream sampling behaviour back for comparison.

	  Expect the comparison build to be slower per cycle, not just noisier. A
	  capture step whose trigger loses the race never sees the library's
	  started event, so it waits out APP_SURVEY_CAPTURE_IDLE_TIMEOUT_SECONDS
	  and logs "did not report done" before moving on. That is the intended
	  handling of a step that does not own its search; it is not a fault.

config APP_SURVEY_CAPTURE_THREAD_STACK_SIZE
	int "Capture thread stack size"
	range 1024 16384
	depends on APP_SURVEY_CAPTURE
	default 4096
	help
	  The cycle keeps its observation snapshot, its record and its trigger
	  message in static buffers rather than on this stack -- each is around a
	  kilobyte.

	  What is left is not small. zbus_chan_pub() runs the whole listener
	  chain synchronously on the publisher's stack, so triggering a step
	  executes survey.c's callback and survey_obs_update() here, on top of
	  this thread's own frames and any deferred logging.

	  Matches the value tests/module/survey_capture builds with, so the only
	  automated exercise of this code runs at the size that ships.

config APP_SURVEY_CAPTURE_WATCHDOG_TIMEOUT_SECONDS
	int "Capture thread watchdog timeout"
	range 1 3600
	depends on APP_SURVEY_CAPTURE
	default 300
	help
	  The capture thread feeds the task watchdog before each step, so this
	  only has to outlast the longest single step -- a GNSS timeout plus its
	  wind-down wait -- not a whole cycle. A build assert enforces that.

	  It exists for one failure: the record store publishes with K_FOREVER,
	  so a storage thread that stops consuming blocks the capture thread
	  forever, and the admission slot it holds is never returned. Surveying
	  would then stop permanently, reporting only "a capture is already
	  running". On a device collecting unattended for a week, a reset is a
	  far better outcome than a silent stop.

config APP_SURVEY_CAPTURE_GNSS_TIMEOUT_SECONDS
	int "Give up on one GNSS step after this long"
	range 1 600
	depends on APP_SURVEY_CAPTURE
	default 180
	help
	  Bounds one bracketing fix, not the search: nothing is cancelled when it
	  expires, because a cancel cannot stop a Wi-Fi scan and leaves the next
	  request returning -EBUSY. The cycle waits for the library to finish on
	  its own and records the step as failed.

	  Shorter than LOCATION_REQUEST_DEFAULT_GNSS_TIMEOUT on purpose: a cycle
	  that spends ten minutes failing to see the sky produces one record;
	  three that spend three minutes each produce three, and the radio
	  observations are what the survey is for.

	  location.c applies this value to the library's own per-request GNSS
	  timeout for the survey's triggers, so the two cannot disagree. They
	  must not: a step that gives up at 180 s while the library searches on
	  until 600 s leaves the modem busy, and the cycle's next two triggers
	  are then discarded -- three steps reported, nothing stored, and the
	  modem still busy when the next cycle starts.

config APP_SURVEY_CAPTURE_SCAN_TIMEOUT_SECONDS
	int "Give up on the scan step after this long"
	range 1 600
	depends on APP_SURVEY_CAPTURE
	default 60
	help
	  Measured Wi-Fi plus cellular scans complete in about 5-10 s. This is
	  generous by design; it exists to stop a wedged modem from stalling the
	  cycle forever, not to bound normal operation.

config APP_SURVEY_CAPTURE_IDLE_TIMEOUT_SECONDS
	int "Wait this long for a finished search to wind down"
	range 1 600
	depends on APP_SURVEY_CAPTURE
	default 30
	help
	  The Location library publishes its result before it reports the search
	  done, and a trigger sent in that gap is discarded. Each step waits here
	  for the done event before the next trigger, which is what makes the
	  sequence real rather than hopeful.

config APP_SURVEY_CAPTURE_INTERVAL_SECONDS
	int "Seconds between automatic capture cycles"
	range 5 3600
	depends on APP_SURVEY_CAPTURE
	default 20
	help
	  FW-7: the device must record while driving with no console attached, so a
	  capture has to start itself. This is the period of the timer that calls
	  survey_capture_request(SURVEY_PROFILE_FAST) on its own, with no shell
	  command needed.

	  10-30 s is the FW-7 target; 20 s is the midpoint. A tick that lands while
	  the previous cycle is still running (which can take up to
	  SURVEY_CAPTURE_WORST_CASE_SECONDS, minutes if GNSS is struggling) is not
	  queued -- survey_capture_request() returns -EALREADY, the tick is
	  dropped, and the timer reschedules for another full interval from then.
	  So this is a floor on the gap between cycles, not a guaranteed cadence;
	  see docs/common/dev_workflow.md for what was measured.

	  Runtime-settable: "survey interval [seconds]" reads or changes this
	  without a reboot, per FW-7 ("runtime-settable via shell"). The Kconfig
	  default is only where it starts at boot.

config APP_SURVEY_CAPTURE_CADENCE_AUTOSTART
	bool
	depends on APP_SURVEY_CAPTURE
	default y
	help
	  Hidden: no prompt, nothing to set from a config fragment. Exists only so that
	  tests/module/survey_capture's CMakeLists can leave it undefined, which compiles out
	  the SYS_INIT that starts the FW-7 cadence timer.

	  That suite drives survey_capture_request() directly against millisecond-scale
	  fakes and asserts on the exact request/response sequence; a real timer left running
	  would eventually call survey_capture_request() on its own mid-suite and turn a
	  deterministic test flaky. Every real build keeps this on.

config APP_SURVEY_EXPORT
	bool "Restrict MCUmgr fs_mgmt to read-only access under /att_storage"
	depends on APP_SURVEY_STORAGE
	depends on MCUMGR_GRP_FS_FILE_ACCESS_HOOK
	default y if MCUMGR_GRP_FS_FILE_ACCESS_HOOK
	help
	  Registers a fs_mgmt file-access callback that denies every access type except a
	  read, and denies reads outside /att_storage. Without it, fs_mgmt's own access
	  hook is unregistered and "fs upload" can write any path -- including the header
	  files that both the storage backend and the boot-time sequence recovery in
	  survey_store.c trust without validating.

	  Default y whenever the hook Kconfig is available, because an export build with
	  the transport enabled and this left off is a build that shipped the
	  vulnerability the hook exists to close.

module = APP_SURVEY
module-str = Survey
source "subsys/logging/Kconfig.template.log_config"

endif # APP_SURVEY
```

## west.yml
```yaml
# Copyright (c) 2024 Nordic Semiconductor
# SPDX-License-Identifier: LicenseRef-Nordic-5-Clause

manifest:
  self:
    west-commands: scripts/west-commands.yml
    path: project

  remotes:
    - name: ncs
      url-base: https://github.com/nrfconnect
    - name: memfault
      url-base: https://github.com/memfault

  projects:
    - name: nrf
      remote: ncs
      repo-path: sdk-nrf
      revision: main
      import: true
    - name: memfault-firmware-sdk
      remote: memfault
      repo-path: memfault-firmware-sdk
      revision: gminn/1.35.0+coap-conn-id-sharing
```
